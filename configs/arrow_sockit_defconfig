## configs/arrow_sockit_defconfig
```kconfig
BR2_arm=y
BR2_cortex_a9=y
BR2_ARM_EABIHF=y
BR2_ARM_ENABLE_NEON=y
BR2_ARM_FPU_NEON=y
BR2_ARM_INSTRUCTIONS_THUMB2=y
BR2_KERNEL_HEADERS_3_9=y
BR2_TOOLCHAIN_BUILDROOT_EGLIBC=y
BR2_TARGET_GENERIC_ROOT_PASSWD="letmein"
BR2_TARGET_GENERIC_GETTY_BAUDRATE_57600=y
BR2_LINUX_KERNEL=y
BR2_LINUX_KERNEL_CUSTOM_GIT=y
BR2_LINUX_KERNEL_CUSTOM_GIT_REPO_URL="http://git.rocketboards.org/linux-socfpga.git"
BR2_LINUX_KERNEL_CUSTOM_GIT_VERSION="rel_13.07_RC5"
BR2_LINUX_KERNEL_DEFCONFIG="socfpga"
BR2_LINUX_KERNEL_UIMAGE_LOADADDR="0x8000"
BR2_LINUX_KERNEL_DTS_SUPPORT=y
BR2_LINUX_KERNEL_USE_CUSTOM_DTS=y
BR2_LINUX_KERNEL_CUSTOM_DTS_PATH="$(TOPDIR)/board/arrow/sockit/socfpga_cyclone5_sockit.dts"
BR2_PACKAGE_DROPBEAR=y
BR2_PACKAGE_DROPBEAR_DISABLE_REVERSEDNS=y
BR2_TARGET_ROOTFS_EXT2=y
BR2_TARGET_ROOTFS_EXT2_3=y
BR2_TARGET_UBOOT=y
BR2_TARGET_UBOOT_BOARDNAME="socfpga_cyclone5"
BR2_TARGET_UBOOT_CUSTOM_GIT=y
BR2_TARGET_UBOOT_CUSTOM_GIT_REPO_URL="http://git.rocketboards.org/u-boot-socfpga.git"
BR2_TARGET_UBOOT_CUSTOM_GIT_VERSION="rel_acds13.0sp1"
BR2_TARGET_UBOOT_FORMAT_IMG=y
```
